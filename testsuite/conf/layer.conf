## testsuite/conf/layer.conf
```bitbake
BBPATH .= ":${LAYERDIR}"
BBFILES += "${LAYERDIR}/recipes-*/*/*.bb \
            ${LAYERDIR}/recipes-*/*/*.bbappend"

BBFILE_COLLECTIONS += "test-k"
BBFILE_PATTERN_test-k = "^${LAYERDIR}/"
BBFILE_PRIORITY_test-k = "10"

LAYERSERIES_COMPAT_test-k = "v0.6"

LAYERDIR_test-k = "${LAYERDIR}"
```
